## config/west.yml
```yaml
manifest:
  remotes:
    - name: zmkfirmware
      url-base: https://github.com/zmkfirmware
    - name: tuanha168
      url-base: https://github.com/tuanha168
  projects:
    - name: zmk
      remote: tuanha168
      revision: 247d841d46193e3f8977010869e91612cec4c014
      import: app/west.yml
    - name: zmk-dongle-screen
      remote: tuanha168
      revision: dada6b7e7d01695a964f4b7f18aca716a607d5cb
    - name: zmk-hid-io
      remote: tuanha168
      revision: 43860bb1008c86c4dac2c0dc566fe8ecda0f2a17
  self:
    path: config
```
